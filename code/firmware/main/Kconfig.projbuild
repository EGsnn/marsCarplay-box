## code/firmware/main/Kconfig.projbuild
```kconfig
menu "USB iAP2 probe"
config PROBE_AP_PASSWORD
    string "Debug hotspot password"
    default ""
endmenu
```

## code/firmware/sdkconfig.defaults
```kconfig
CONFIG_IDF_TARGET="esp32s3"
CONFIG_ESPTOOLPY_FLASHSIZE_16MB=y
CONFIG_SPIRAM=y
CONFIG_SPIRAM_MODE_OCT=y
CONFIG_SPIRAM_SPEED_80M=y
CONFIG_SPIRAM_USE_MALLOC=y
CONFIG_ESP_DEFAULT_CPU_FREQ_MHZ_240=y
CONFIG_COMPILER_OPTIMIZATION_PERF=y
CONFIG_FREERTOS_HZ=1000
CONFIG_ESP_MAIN_TASK_STACK_SIZE=8192
CONFIG_ESP_CONSOLE_UART_DEFAULT=y
CONFIG_ESP_CONSOLE_USB_SERIAL_JTAG=n
CONFIG_PARTITION_TABLE_CUSTOM=y
CONFIG_PARTITION_TABLE_CUSTOM_FILENAME="partitions.csv"
CONFIG_TINYUSB_VENDOR_COUNT=1
CONFIG_TINYUSB_VENDOR_RX_BUFSIZE=4096
CONFIG_TINYUSB_VENDOR_TX_BUFSIZE=4096
CONFIG_TINYUSB_VENDOR_EPSIZE=64
CONFIG_TINYUSB_NET_MODE_NCM=y
CONFIG_TINYUSB_NCM_OUT_NTB_BUFFS_COUNT=3
CONFIG_TINYUSB_NCM_IN_NTB_BUFFS_COUNT=3
CONFIG_TINYUSB_NCM_OUT_NTB_BUFF_MAX_SIZE=3200
CONFIG_TINYUSB_NCM_IN_NTB_BUFF_MAX_SIZE=3200

CONFIG_MBEDTLS_CHACHA20_C=y
CONFIG_MBEDTLS_CHACHAPOLY_C=y

CONFIG_LWIP_MAX_SOCKETS=16

# build.py supplies PROBE_AP_PASSWORD through ignored build/wifi.defaults.

CONFIG_SPIRAM_MALLOC_ALWAYSINTERNAL=512
CONFIG_SPIRAM_MALLOC_RESERVE_INTERNAL=65536
CONFIG_ESP32S3_DATA_CACHE_64KB=y
CONFIG_ESP32S3_DATA_CACHE_LINE_64B=y
```
